## drivers/huawei_platform/touthscreen/panel/Kconfig
```kconfig
#
# huawei touchscreen driver configuration
#

config SYNAPTICS_TS
	bool "synaptics touchscreen"
	default n
	help
	  If you say yes here you get support for synaptics touchscreen.
config SYNAPTICS_LCD_TYPE
	bool "synaptics touchscreen"
	default n
	help
	  If you say yes here you get support for synaptics touchscreen.
config CYPRESS_TS
	bool "cypress touchscreen"
	default n
	help
	  If you say yes here you get support for cypress touchscreen.
config WACOM_TS
	bool "wacom touchscreen"
	default n
	help
	  If you say yes here you get support for wacom touchscreen.
```
